## esp32-espidf-hm4.8-miniproject-iot_logger/main/Kconfig.projbuild
```kconfig
menu "IoT Logger Configuration"
    config IOT_LOGGER_MQTT_BROKER_URI
        string "MQTT broker URI (mqtt://IP:1883)"
        default "mqtt://192.168.0.143:1883"
        help
            IP-address from Mosquitto in the same Wi-Fi where IoT Logger connected via provisioning

    config IOT_LOGGER_MQTT_CLIENT_IDENTIFIER
        string "MQTT Client ID"
        default "esp32s3-iot-logger-01"

    config IOT_LOGGER_PROVISIONING_PIN
        string "Provisioning Pin"
        default "iot logger"
        help
            Pin for SoftAP provisioning in ESP SoftAp Prov app
endmenu
```
